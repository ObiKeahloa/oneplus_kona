## drivers/soc/oplus/system/cmdline_parser/Kconfig
```kconfig
# SPDX-License-Identifier: GPL-2.0-only
# Copyright (C) 2018-2020 Oplus. All rights reserved.

config OPLUS_FEATURE_CMDLINE
  tristate "Oplus command line"
  default n
  help
        define this config to get command line.

config OPLUS_FEATURE_ANDROIDBOOT
  tristate "Oplus android boot"
  default n
  help
    define this config to get android boot cmdline.

config OPLUS_FEATURE_SIMCARDNUM
  tristate "Oplus simcardnum"
  default n
  help
      define this config to get simcardnum cmdline.
```
